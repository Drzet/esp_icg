## main/Kconfig.projbuild
```kconfig
menu "ICG prototype"

config ICG_SD_SCLK_GPIO
    int "SD SCLK GPIO"
    default -1
    range -1 55

config ICG_SD_MOSI_GPIO
    int "SD MOSI GPIO"
    default -1
    range -1 55

config ICG_SD_MISO_GPIO
    int "SD MISO GPIO"
    default -1
    range -1 55

config ICG_SD_CS_GPIO
    int "SD CS GPIO"
    default -1
    range -1 55

config ICG_JPEG_QUALITY
    int "Recording JPEG quality"
    default 80
    range 1 100

config ICG_RECORD_MAX_WIDTH
    int "Maximum record width"
    default 1280
    range 320 4096

config ICG_RECORD_MAX_HEIGHT
    int "Maximum record height"
    default 960
    range 240 3072

endmenu
```

## sdkconfig.defaults
```kconfig
CONFIG_IDF_TARGET="esp32p4"

# WT9932P4-TINY: ESP32-P4 v1.x, 16 MB flash, 32 MB in-package PSRAM.
CONFIG_ESPTOOLPY_FLASHSIZE_16MB=y
CONFIG_ESPTOOLPY_FLASHSIZE="16MB"
CONFIG_ESP32P4_SELECTS_REV_LESS_V3=y
CONFIG_ESP32P4_REV_MIN_1=y
CONFIG_ESP32P4_REV_MIN_FULL=1

CONFIG_ESP_DEFAULT_CPU_FREQ_MHZ_360=y
CONFIG_COMPILER_OPTIMIZATION_PERF=y
CONFIG_ESP_MAIN_TASK_STACK_SIZE=12288
CONFIG_FREERTOS_HZ=1000

CONFIG_SPIRAM=y
CONFIG_SPIRAM_MODE_HEX=y
CONFIG_SPIRAM_SPEED_200M=y
CONFIG_SPIRAM_BOOT_INIT=y
CONFIG_SPIRAM_MALLOC_ALWAYSINTERNAL=4096
CONFIG_CACHE_L2_CACHE_256KB=y
CONFIG_CACHE_L2_CACHE_LINE_128B=y

CONFIG_IDF_EXPERIMENTAL_FEATURES=y

# OV9281 native Espressif sensor driver:
# 2-lane CSI, RAW8, 1280x720 @ 50 fps.
CONFIG_ESP_VIDEO_ENABLE_MIPI_CSI_VIDEO_DEVICE=y
CONFIG_CAMERA_OV9281=y
CONFIG_CAMERA_OV9281_AUTO_DETECT_MIPI_INTERFACE_SENSOR=y
CONFIG_CAMERA_OV9281_MIPI_RAW8_640X400_100FPS=y
CONFIG_CAMERA_OV9281_MIPI_RAW8_1280X720_50FPS=y
# CONFIG_CAMERA_OV9281_MIPI_DEFAULT_FMT_RAW8_640X400_100FPS is not set
CONFIG_CAMERA_OV9281_MIPI_DEFAULT_FMT_RAW8_1280X720_50FPS=y
CONFIG_CAMERA_OV9281_SID_LOW=y

CONFIG_FATFS_ALLOC_PREFER_EXTRAM=n
CONFIG_FATFS_IMMEDIATE_FSYNC=n
```
